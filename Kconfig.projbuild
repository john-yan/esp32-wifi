## Kconfig.projbuild
```kconfig
menu "esp32-wifi Configuration"

config WIFI_SSID
    string "wifi ssid"
    default "XXXXXXXX"

config WIFI_PASSWORD
    string "wifi password"
    default "12345678"

endmenu
```
